## arch/arm/mach-rockchip/rk3588/Kconfig
```kconfig
if ROCKCHIP_RK3588

config TARGET_EVB_RK3588
	bool "EVB_RK3588"
	select BOARD_LATE_INIT
	help
	  RK3588 EVB is a evaluation board for Rockchp RK3588.

config SYS_SOC
	default "rockchip"

config SYS_MALLOC_F_LEN
	default 0x400

config TARGET_RK3588_AXON
	bool "Vicharak RK3588 Axon board"
	select BOARD_LATE_INIT
	help
	  The Axon is a Single Board Computer (SBC) designed by Vicharak,
	  which is powered by the RK3588 processor.

	  The board features a dual-channel DDR4 RAM configuration
	  with a total capacity of 8GB, as well as storage options
	  including SATA, NVMe, eMMC, and SDMMC.

	  Other notable features include a 1GBps LAN connection,
	  RTL8852BS-based WiFi and Bluetooth module,
	  ES8388 Audio codec support, MIPI CSI RX x 2,
	  MIPI DCPHY RX x 2, MIPI DCPHY TX x 2 and 3 x PCIe 2.0 and 1 x 3.0 slots.

	  The Axon also includes a variety of header pins
	  for UART, I2C, SPI, and SARADC connectivity,
	  as well as micro HDMI ports and
	  2 x USB Type-C connectors for power delivery, 3.1 USB and DP.

config TARGET_RK3588_AXON_CM_EVB1
	bool "Vicharak RK3588 Axon Computer Module Evolution board 1"
	select BOARD_LATE_INIT
	help
	The AXON-CM is a compact, high-performance System-on-Module (SoM)
	based on the Rockchip RK3588 octa-core processor, featuring world's
	first integrated on-board Wi-Fi and Bluetooth module.

	Axon CM EV1 Includes:

	1x PCIe2.0 : 4G/5G Module + GPS
	2x USB2.0  : External USB Ports
	1x RGMII   : Ethernet (via PHY IC)
	1x CAN     : OBD_2 (J1962)
	1x HDMI0   : Micro HDMI Connector
	1x I2S     : Audio Codec (ES8388)
	2x I2C     : FPC Connector (AFC42-S24FMA-1H)
	1x DSI     : 2 LANE MIPI Connector

source board/rockchip/evb_rk3588/Kconfig
source board/vicharak/rk3588_axon/Kconfig
source board/vicharak/rk3588_axon_cm_evb1/Kconfig

endif
```

## board/vicharak/rk3588_axon_cm_evb1/Kconfig
```kconfig
if TARGET_RK3588_AXON_CM_EVB1

config SYS_BOARD
	default "rk3588_axon_cm_evb1"

config SYS_VENDOR
	default "vicharak"

config SYS_CONFIG_NAME
	default "rk3588_axon_cm_evb1"

config BOARD_SPECIFIC_OPTIONS
	def_bool y

endif
```
