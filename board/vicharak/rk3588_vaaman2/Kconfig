## board/vicharak/rk3588_vaaman2/Kconfig
```kconfig
if TARGET_RK3588_VAAMAN2

config SYS_BOARD
	default "rk3588_vaaman2"

config SYS_VENDOR
	default "vicharak"

config SYS_CONFIG_NAME
	default "rk3588_vaaman2"

config BOARD_SPECIFIC_OPTIONS
	def_bool y

endif
```
